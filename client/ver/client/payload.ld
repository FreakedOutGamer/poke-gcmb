/* Generated by ../tools/sync_layout.py; do not edit by hand. */
/* The bootstrap decompresses this image to EWRAM and branches to it. */
ENTRY(PayloadStart)
SECTIONS
{
    . = 0x02010000;
    .payload : ALIGN(4)
    {
        build/client/asm/crt0.o(.text)
        build/client/asm/multi_sio_asm.o(.text)
        build/client/src/intr.o(.text)
        build/client/src/gflib/reset.o(.text)
        build/client/src/main.o(.text)
        build/client/src/libpmagb/random.o(.text)
        build/client/src/libpmagb/string_util.o(.text)
        build/client/src/pokemon.o(.text)
        build/client/src/create_box_mon.o(.text)
        build/client/src/calculate_box_mon_checksum.o(.text)
        build/client/src/calculate_mon_stats.o(.text)
        build/client/src/level.o(.text)
        build/client/src/moves.o(.text)
        build/client/src/move_shift.o(.text)
        build/client/src/box_crypto.o(.text)
        build/client/src/get_substruct.o(.text)
        build/client/src/get_mon_data.o(.text)
        build/client/src/get_box_mon_data.o(.text)
        build/client/src/set_mon_data.o(.text)
        build/client/src/set_box_mon_data.o(.text)
        build/client/src/get_species_name.o(.text)
        build/client/src/get_nature.o(.text)
        build/client/src/modify_stat_by_nature.o(.text)
        build/client/src/text.o(.text)
        build/client/src/save.o(.text)
        build/client/src/libpmagb/target_game.o(.text)
        build/client/src/libpmagb/save_data.o(.text)
        build/client/src/jirachi.o(.text)
        build/client/src/give_jirachi.o(.text)
        build/client/src/delivery.o(.text)
        build/client/src/joybus.o(.text)
        build/client/src/multi_sio.o(.text)
        build/client/src/berry_fix.o(.text)
        build/client/src/berry_fix_rtc.o(.text)
        build/client/src/rtc.o(.text)
        build/client/asm/libagbsyscall.o(.text.libagbsyscall)
        build/client/src/agb_flash_v102.o(.text)
        build/client/src/agb_flash_1m_v102.o(.text)
        build/client/src/agb_flash_mx_v102.o(.text)
        build/client/src/siirtc.o(.text)
        build/client/libgcc/_call_via_rX.o(.text)
        build/client/libgcc/_divsi3.o(.text)
        build/client/libgcc/_dvmd_tls.o(.text)
        build/client/libgcc/_modsi3.o(.text)
        build/client/libgcc/_udivsi3.o(.text)
        build/client/libgcc/_umodsi3.o(.text)
        build/client/src/libpmagb/strcmp.o(.text)
        build/client/src/main.o(.rodata)
        . += 0x3;
        build/client/src/bg_graphics.o(.rodata)
        build/client/src/gflib/trig.o(.rodata)
        build/client/src/pokemon_tables.o(.rodata)
        build/client/src/strings.o(.rodata)
        build/client/src/get_species_name.o(.rodata)
        . += 0x2;
        build/client/src/jirachi.o(.data)
        build/client/src/jirachi.o(.rodata)
        build/client/src/libpmagb/target_game.o(.rodata)
        . += 0x3;
        build/client/src/sprite_graphics.o(.rodata)
        build/client/src/multi_sio.o(.rodata)
        . += 0x1;
        build/client/src/berry_fix.o(.rodata)
        build/client/src/rtc.o(.rodata)
        build/client/data/flash.o(.rodata)
        build/client/src/siirtc.o(.rodata)
        build/client/src/variables.o(.data)
    }

    __payload_end = .;
    ASSERT(__payload_end == 0x0201AD14, "payload size changed")

    /* Data these objects emit is still covered by the raw ranges. */
    /DISCARD/ :
    {
        *(.rodata)
        *(.data)
        *(.comment)
        *(.ARM.attributes)
        *(.note.*)
    }
}
