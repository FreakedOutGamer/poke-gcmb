/* Generated by ../tools/sync_layout.py; do not edit by hand. */
/* The bootstrap decompresses this image to EWRAM and branches to it. */
ENTRY(PayloadStart)
SECTIONS
{
    . = 0x02010000;
    .payload : ALIGN(4)
    {
        build/client_2003_1112/asm/crt0.o(.text)
        build/client_2003_1112/asm/multi_sio_asm.o(.text)
        build/client_2003_1112/src/intr.o(.text)
        build/client_2003_1112/src/gflib/reset.o(.text)
        build/client_2003_1112/src/main.o(.text)
        build/client_2003_1112/src/libpmagb/random.o(.text)
        build/client_2003_1112/src/libpmagb/string_util.o(.text)
        build/client_2003_1112/src/pokemon.o(.text)
        build/client_2003_1112/src/create_box_mon.o(.text)
        build/client_2003_1112/src/calculate_box_mon_checksum.o(.text)
        build/client_2003_1112/src/calculate_mon_stats.o(.text)
        build/client_2003_1112/src/level.o(.text)
        build/client_2003_1112/src/moves.o(.text)
        build/client_2003_1112/src/move_shift.o(.text)
        build/client_2003_1112/src/box_crypto.o(.text)
        build/client_2003_1112/src/get_substruct.o(.text)
        build/client_2003_1112/src/get_mon_data.o(.text)
        build/client_2003_1112/src/get_box_mon_data.o(.text)
        build/client_2003_1112/src/set_mon_data.o(.text)
        build/client_2003_1112/src/set_box_mon_data.o(.text)
        build/client_2003_1112/src/get_species_name.o(.text)
        build/client_2003_1112/src/get_nature.o(.text)
        build/client_2003_1112/src/modify_stat_by_nature.o(.text)
        build/client_2003_1112/src/text.o(.text)
        build/client_2003_1112/src/save.o(.text)
        build/client_2003_1112/src/libpmagb/target_game.o(.text)
        build/client_2003_1112/src/libpmagb/save_data.o(.text)
        build/client_2003_1112/src/jirachi.o(.text)
        build/client_2003_1112/src/give_jirachi.o(.text)
        build/client_2003_1112/src/delivery.o(.text)
        build/client_2003_1112/src/joybus.o(.text)
        build/client_2003_1112/src/multi_sio.o(.text)
        build/client_2003_1112/asm/libagbsyscall.o(.text.libagbsyscall)
        build/client_2003_1112/src/agb_flash_v102.o(.text)
        build/client_2003_1112/src/agb_flash_1m_v102.o(.text)
        build/client_2003_1112/src/agb_flash_mx_v102.o(.text)
        build/client_2003_1112/libgcc/_call_via_rX.o(.text)
        build/client_2003_1112/libgcc/_divsi3.o(.text)
        build/client_2003_1112/libgcc/_dvmd_tls.o(.text)
        build/client_2003_1112/libgcc/_modsi3.o(.text)
        build/client_2003_1112/libgcc/_udivsi3.o(.text)
        build/client_2003_1112/libgcc/_umodsi3.o(.text)
        build/client_2003_1112/src/libpmagb/strcmp.o(.text)
        build/client_2003_1112/src/main.o(.rodata)
        build/client_2003_1112/src/bg_graphics.o(.rodata)
        build/client_2003_1112/src/gflib/trig.o(.rodata)
        build/client_2003_1112/src/pokemon_tables.o(.rodata)
        build/client_2003_1112/src/strings.o(.rodata)
        build/client_2003_1112/src/get_species_name.o(.rodata)
        . += 0x1;
        build/client_2003_1112/src/jirachi.o(.data)
        build/client_2003_1112/src/jirachi.o(.rodata)
        build/client_2003_1112/src/libpmagb/target_game.o(.rodata)
        . += 0x3;
        build/client_2003_1112/src/sprite_graphics.o(.rodata)
        build/client_2003_1112/src/multi_sio.o(.rodata)
        . += 0x1;
        build/client_2003_1112/data/flash.o(.rodata)
        build/client_2003_1112/src/variables.o(.data)
    }

    __payload_end = .;
    ASSERT(__payload_end == 0x020197F0, "payload size changed")

    /* Data these objects emit is still covered by the raw ranges. */
    /DISCARD/ :
    {
        *(.rodata)
        *(.data)
        *(.comment)
        *(.ARM.attributes)
        *(.note.*)
    }
}
