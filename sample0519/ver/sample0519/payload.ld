/* Generated by ../tools/sync_layout.py; do not edit by hand. */
/* The bootstrap decompresses this image to EWRAM and branches to it. */
ENTRY(PayloadStart)
SECTIONS
{
    . = 0x02018000;
    .payload : ALIGN(4)
    {
        build/sample0519/asm/crt0.o(.text)
        build/sample0519/src/main.o(.text)
        build/sample0519/src/text.o(.text)
        build/sample0519/src/save.o(.text)
        build/sample0519/src/libpmagb/random.o(.text)
        build/sample0519/src/libpmagb/string_util.o(.text)
        build/sample0519/src/pokedex.o(.text)
        build/sample0519/src/pokemon.o(.text)
        build/sample0519/src/create_box_mon.o(.text)
        build/sample0519/src/calculate_box_mon_checksum.o(.text)
        build/sample0519/src/calculate_mon_stats.o(.text)
        build/sample0519/src/move_shift.o(.text)
        build/sample0519/src/box_crypto.o(.text)
        build/sample0519/src/get_substruct.o(.text)
        build/sample0519/src/get_mon_data.o(.text)
        build/sample0519/src/get_box_mon_data.o(.text)
        build/sample0519/src/set_mon_data.o(.text)
        build/sample0519/src/set_box_mon_data.o(.text)
        build/sample0519/src/give_mon.o(.text)
        build/sample0519/src/get_species_name.o(.text)
        build/sample0519/src/calculate_pp.o(.text)
        build/sample0519/src/get_nature.o(.text)
        build/sample0519/src/modify_stat_by_nature.o(.text)
        build/sample0519/src/move_tutor.o(.text)
        build/sample0519/src/pokedex_num.o(.text)
        build/sample0519/src/rtc.o(.text)
        build/sample0519/src/delivery.o(.text)
        build/sample0519/src/joybus.o(.text)
        build/sample0519/asm/libagbsyscall.o(.text.libagbsyscall)
        build/sample0519/src/agb_flash_v102.o(.text)
        build/sample0519/src/agb_flash_1m_v102.o(.text)
        build/sample0519/src/agb_flash_mx_v102.o(.text)
        build/sample0519/src/siirtc.o(.text)
        build/sample0519/libgcc/_call_via_rX.o(.text)
        build/sample0519/libgcc/_divsi3.o(.text)
        build/sample0519/libgcc/_dvmd_tls.o(.text)
        build/sample0519/libgcc/_modsi3.o(.text)
        build/sample0519/libgcc/_udivsi3.o(.text)
        build/sample0519/libgcc/_umodsi3.o(.text)
        build/sample0519/libc/memcmp.o(.text)
        build/sample0519/libc/memcpy.o(.text)
        build/sample0519/libc/strcpy.o(.text)
        build/sample0519/libc/vsprintf.o(.text)
        build/sample0519/libc/vfprintf.o(.text)
        build/sample0519/libc/wsetup.o(.text)
        build/sample0519/libc/dtoa.o(.text)
        build/sample0519/libc/fflush.o(.text)
        build/sample0519/libc/findfp.o(.text)
        build/sample0519/libc/freer.o(.text)
        build/sample0519/libc/fvwrite.o(.text)
        build/sample0519/libc/fwalk.o(.text)
        build/sample0519/libc/locale.o(.text)
        build/sample0519/libc/makebuf.o(.text)
        build/sample0519/libc/mallocr.o(.text)
        build/sample0519/libc/mbtowc_r.o(.text)
        build/sample0519/libc/memchr.o(.text)
        build/sample0519/libc/memmove.o(.text)
        build/sample0519/libc/memset.o(.text)
        build/sample0519/libc/mlock.o(.text)
        build/sample0519/libc/mprec.o(.text)
        build/sample0519/libc/s_isinf.o(.text)
        build/sample0519/libc/s_isnan.o(.text)
        build/sample0519/libc/sbrkr.o(.text)
        build/sample0519/libc/stdio.o(.text)
        build/sample0519/src/libpmagb/strcmp.o(.text)
        build/sample0519/libc/strlen.o(.text)
        build/sample0519/libc/syscalls.o(.text)
        build/sample0519/libc/writer.o(.text)
        build/sample0519/libc/callocr.o(.text)
        build/sample0519/libc/closer.o(.text)
        build/sample0519/libc/errno.o(.text)
        build/sample0519/libc/fstatr.o(.text)
        build/sample0519/libc/libcfunc.o(.text)
        build/sample0519/libc/lseekr.o(.text)
        build/sample0519/libc/readr.o(.text)
        build/sample0519/libgcc/dp-bit.o(.text)
        build/sample0519/libgcc/fp-bit.o(.text)
        build/sample0519/libgcc/_lshrdi3.o(.text)
        build/sample0519/libgcc/_muldi3.o(.text)
        build/sample0519/libgcc/_negdi2.o(.text)
        build/sample0519/src/main.o(.rodata)
        build/sample0519/src/text.o(.rodata)
        build/sample0519/src/save.o(.rodata)
        . += 0x2;
        build/sample0519/src/pokemon_tables.o(.rodata)
        build/sample0519/src/rtc.o(.rodata)
        build/sample0519/src/delivery_data.o(.rodata)
        build/sample0519/data/flash.o(.rodata)
        build/sample0519/src/siirtc.o(.rodata)
        build/sample0519/src/graphics.o(.rodata)
        build/sample0519/libc/impure.o(.rodata)
        . += 0x2;
        build/sample0519/libc/vfprintf.o(.rodata)
        . += 0x2;
        build/sample0519/libc/dtoa.o(.rodata)
        . += 0x2;
        build/sample0519/libc/locale.o(.rodata)
        . += 0x2;
        build/sample0519/libc/mprec.o(.rodata)
        build/sample0519/libc/syscalls.o(.rodata)
        . += 0x3;
        build/sample0519/src/variables.o(.data)
        build/sample0519/src/delivery_data.o(.data)
        build/sample0519/libc/impure.o(.data)
        build/sample0519/libc/locale.o(.data)
        build/sample0519/libc/mallocr.o(.data)
    }

    __payload_end = .;
    ASSERT(__payload_end == 0x020336CC, "payload size changed")

    .bss.libc_syscalls_o 0x030009C0 (NOLOAD) : { build/sample0519/libc/syscalls.o(.bss) }
    .bss.libgcc_dp_bit_o 0x03000A70 (NOLOAD) : { build/sample0519/libgcc/dp-bit.o(.bss) }
    .bss.libgcc_fp_bit_o 0x03000A88 (NOLOAD) : { build/sample0519/libgcc/fp-bit.o(.bss) }

    /* Data these objects emit is still covered by the raw ranges. */
    /DISCARD/ :
    {
        *(.rodata)
        *(.data)
        *(.comment)
        *(.ARM.attributes)
        *(.note.*)
    }
}
